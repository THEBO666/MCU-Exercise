/**********************HJ-3G实验开发板例程************************
*  平台：HJ-3G V6.0 + Keil U3 + STC89C52
*  名称：C语言学习实验
*  公司：慧净电子科技有限公司
*  淘宝：http://shop37031453.taobao.com       
*  网站：www.hlmcu.com
*  编写：
*  日期：2008-8-08
*   QQ : 121350852  398115088
*  晶振:11.0592MHZ
*  说明：免费开源，不提供源代码分析，有问题直接到慧净论坛交流
*  论坛：http://hjdz.5d6d.com
******************************************************************
程序功能：	 通过P1口的展示，对比说明逻辑与或非和按位与或非之间的差别。
			 当HJ-3G实验板上的s2被按下时，执行的为按位与；
			 当HJ-3G实验板上的s3被按下时，执行的为逻辑与；
			 当HJ-3G实验板上的s4被按下时，执行的为按位或；
			 当HJ-3G实验板上的s5被按下时，执行的为逻辑或。
****************************************************************************/
#include <reg51.h>

sbit s2=P3^4;
sbit s3=P3^5;
sbit s4=P3^6;
sbit s5=P3^7;

void main()
{
	char i=1,j=2;
	while(1)
	{
		if(s2==0)
			P1=i&j;	  //按位与，程序会将1与2均转换为二进制，对于每个位进行与运算，如果结果不为0，则为True
				  //故此时，即为0000 0001&0000 0010=0000 0000，结果为0，HJ-3G学习板第一个led会亮	
		else
			P1=0xff;

		if(s3==0)
			P1=i&&j; //逻辑与，只要i和j均不为0，则结果为真（1），第一个led会灭。
		else
			P1=0xff;

		if(s4==0)
			P1=i|j;  //按位或与逻辑或的差别与上面类似。
		else
			P1=0xff;

		if(s5==0)
			P1=i||j;
		else
			P1=0xff;
	}
}
