#include "RTX51TNY.h"
#include "reg52.h"
sbit led0=P1^0;
sbit led1=P2^0;
/*******************************************************************************
* 函 数 名       : task_create
* 函数功能		 	 : 任务0
* 输    入       : 无
* 输    出    	 : 无
*******************************************************************************/
void task_create(void) _task_ 0
{
	os_create_task(1);
	os_create_task(2);
	os_delete_task(0);
	while(1)
	{
		;
	}		
}
/*******************************************************************************
* 函 数 名       : task_1
* 函数功能		 	 : 任务1
* 输    入       : 无
* 输    出    	 : 无
*******************************************************************************/
void task_1(void) _task_ 1
{
	while(1)
	{
		led0=!led0;
		os_wait2(K_IVL,50);
	}		
}

/*******************************************************************************
* 函 数 名       : task_2
* 函数功能		 	 : 任务2
* 输    入       : 无
* 输    出    	 : 无
*******************************************************************************/
void task_2(void) _task_ 2
{
	while(1)
	{
		led1=!led1;
		os_wait2(K_IVL,400);
	}		
}


	
